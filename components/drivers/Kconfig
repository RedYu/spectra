## components/drivers/Kconfig
```kconfig
menu "Spectra drivers"

    config CAN_FD_MCP2518FD_ENABLE_PROFILING
        bool "Enable MCP2518FD performance profiling"
        default n
        help
            Collect MCP2518FD interrupt, SPI, FIFO update and frame
            decoding timing statistics.

            Profiling adds timestamp reads and atomic counter updates
            to the receive path. Enable it only for performance
            diagnostics.

endmenu
```

## components/services/Kconfig
```kconfig
menu "Spectra diagnostics"

config SPECTRA_SD_BENCHMARK_ON_STARTUP
    bool "Run SD-card benchmark during startup"
    default n
    help
        Run a destructive sequential write/read test after mounting
        the SD card. Intended only for development diagnostics.

endmenu

menu "Spectra OTA backend"

config SPECTRA_OTA_BACKEND_CHECK_URL
    string "Firmware update check URL"
    default "https://api.spectra.ridel.com.ua/firmware/check"
    help
        HTTPS endpoint queried by the device for firmware availability.
        A successful response without an update manifest means that no
        update is available. The URL can later be changed to the firmware
        manifest endpoint without changing device code.

config SPECTRA_OTA_BACKEND_CHECK_INTERVAL_MINUTES
    int "Firmware update check interval in minutes"
    range 5 10080
    default 360
    help
        Interval between automatic backend firmware checks while the
        Station interface has Internet access.

endmenu

menu "Spectra web content"

config SPECTRA_WEB_CONTENT_GZIP
    bool "Serve precompressed web resources"
    default n
    help
        Minify text resources and gzip every file from web_src during
        the project build. The generated spiffs_data/www directory
        contains only gzip files. The browser receives the
        Content-Encoding: gzip header.

config SPECTRA_WEB_CONTENT_CACHE
    bool "Enable browser caching for static web resources"
    default n
    help
        Allow browsers to cache HTML, CSS, JavaScript and favicon
        resources. When disabled, the server sends Cache-Control:
        no-store.

config SPECTRA_WEB_CONTENT_CACHE_MAX_AGE
    int "Static resource cache lifetime in seconds"
    depends on SPECTRA_WEB_CONTENT_CACHE
    range 0 31536000
    default 3600
    help
        Number of seconds for which a browser may reuse a static web
        resource without requesting it again.

endmenu
```

## sdkconfig.defaults
```kconfig
CONFIG_IDF_TARGET="esp32s3"
CONFIG_APP_PROJECT_VER_FROM_CONFIG=n

#
# FreeRTOS
#
CONFIG_FREERTOS_USE_TRACE_FACILITY=y
CONFIG_FREERTOS_USE_STATS_FORMATTING_FUNCTIONS=y
CONFIG_FREERTOS_VTASKLIST_INCLUDE_COREID=y
CONFIG_FREERTOS_GENERATE_RUN_TIME_STATS=y

#
# LVGL examples and demos
#
CONFIG_LV_BUILD_EXAMPLES=n

CONFIG_LV_USE_DEMO_WIDGETS=n
CONFIG_LV_USE_DEMO_KEYPAD_AND_ENCODER=n
CONFIG_LV_USE_DEMO_BENCHMARK=n
CONFIG_LV_USE_DEMO_RENDER=n
CONFIG_LV_USE_DEMO_STRESS=n
CONFIG_LV_USE_DEMO_MUSIC=n
CONFIG_LV_USE_DEMO_FLEX_LAYOUT=n
CONFIG_LV_USE_DEMO_MULTILANG=n
CONFIG_LV_USE_DEMO_TRANSFORM=n
CONFIG_LV_USE_DEMO_SCROLL=n
CONFIG_LV_USE_DEMO_VECTOR_GRAPHIC=n

#
# Fonts
#
CONFIG_LV_FONT_MONTSERRAT_14=y
CONFIG_LV_FONT_MONTSERRAT_16=y
CONFIG_LV_FONT_MONTSERRAT_18=y
CONFIG_LV_FONT_MONTSERRAT_20=y
CONFIG_LV_FONT_UNSCII_8=y

#
# Flash
#
CONFIG_ESPTOOLPY_FLASHSIZE_16MB=y

#
# Partition table
#
CONFIG_PARTITION_TABLE_CUSTOM=y
CONFIG_PARTITION_TABLE_CUSTOM_FILENAME="partitions.csv"

#
# USB RNDIS
#
CONFIG_TINYUSB_NET_MODE_ECM_RNDIS=y
# CONFIG_TINYUSB_NET_MODE_NCM is not set
# CONFIG_TINYUSB_NET_MODE_NONE is not set

CONFIG_TINYUSB_DESC_USE_ESPRESSIF_VID=y
CONFIG_TINYUSB_DESC_USE_DEFAULT_PID=y

CONFIG_ESP_CONSOLE_UART_DEFAULT=y

CONFIG_LWIP_DHCPS=y

#
# PSRAM
#
CONFIG_SPIRAM=y
CONFIG_SPIRAM_MODE_OCT=y
CONFIG_SPIRAM_SPEED_80M=y
CONFIG_SPIRAM_USE_MALLOC=y
CONFIG_SPIRAM_TRY_ALLOCATE_WIFI_LWIP=y
CONFIG_SPIRAM_MALLOC_RESERVE_INTERNAL=65536
CONFIG_SPIRAM_MALLOC_ALWAYSINTERNAL=1024
CONFIG_SPIRAM_ALLOW_STACK_EXTERNAL_MEMORY=y

#
# Wi-Fi memory
#
CONFIG_ESP_WIFI_STATIC_RX_BUFFER_NUM=6
CONFIG_ESP_WIFI_DYNAMIC_RX_BUFFER_NUM=16
CONFIG_ESP_WIFI_DYNAMIC_TX_BUFFER_NUM=16
CONFIG_ESP_WIFI_RX_BA_WIN=6

CONFIG_ESP_COREDUMP_TO_FLASH_OR_UART=y
CONFIG_ESP_COREDUMP_ENABLE_TO_FLASH=y
CONFIG_ESP_COREDUMP_DATA_FORMAT_ELF=y
CONFIG_ESP_COREDUMP_CHECKSUM_SHA256=y
CONFIG_ESP_COREDUMP_MAX_TASKS_NUM=16
CONFIG_ESP_COREDUMP_STACK_SIZE=2048

CONFIG_MBEDTLS_CERTIFICATE_BUNDLE=y
CONFIG_MBEDTLS_CERTIFICATE_BUNDLE_DEFAULT_FULL=y
CONFIG_MBEDTLS_DYNAMIC_BUFFER=y
CONFIG_MBEDTLS_DYNAMIC_FREE_CONFIG_DATA=y
CONFIG_MBEDTLS_DYNAMIC_FREE_CA_CERT=y
CONFIG_MBEDTLS_SSL_KEEP_PEER_CERTIFICATE=n
CONFIG_MBEDTLS_HARDWARE_AES=y
CONFIG_MBEDTLS_AES_USE_INTERRUPT=y
CONFIG_MBEDTLS_HARDWARE_SHA=y
CONFIG_MBEDTLS_HARDWARE_MPI=y
CONFIG_MBEDTLS_HARDWARE_ECC=y
CONFIG_MBEDTLS_EXTERNAL_MEM_ALLOC=y
CONFIG_MBEDTLS_INTERNAL_MEM_ALLOC=n

CONFIG_ESP_NETIF_SET_DNS_PER_DEFAULT_NETIF=y

CONFIG_ESP_DEFAULT_CPU_FREQ_MHZ_240=y
CONFIG_ESP_DEFAULT_CPU_FREQ_MHZ=240

CONFIG_LOG_DYNAMIC_LEVEL_CONTROL=y
CONFIG_LOG_MAXIMUM_LEVEL_DEBUG=y

CONFIG_HTTPD_WS_SUPPORT=y
```
